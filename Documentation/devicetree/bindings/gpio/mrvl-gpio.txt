## Documentation/devicetree/bindings/gpio/mrvl-gpio.txt
```
* Marvell PXA GPIO controller

Required properties:
- compatible : Should be "mrvl,pxa-gpio" or "mrvl,mmp-gpio"
- reg : Address and length of the register set for the device
- interrupts : Should be the port interrupt shared by all gpio pins, if
- interrupt-name : Should be the name of irq resource.
  one number.
- gpio-controller : Marks the device node as a gpio controller.
- #gpio-cells : Should be one.  It is the pin number.

Example:

	gpio: gpio@d4019000 {
		compatible = "mrvl,mmp-gpio", "mrvl,pxa-gpio";
		reg = <0xd4019000 0x1000>;
		interrupts = <49>, <17>, <18>;
		interrupt-name = "gpio_mux", "gpio0", "gpio1";
		gpio-controller;
		#gpio-cells = <1>;
		interrupt-controller;
		#interrupt-cells = <1>;
      };

* Marvell orion / kirkwood GPIO controller

Required properties:
- compatible : should be at least "mrvl,orion-gpio"
- reg : address/length of the gpio registers
- interrupts : base interrupt for the gpios
- #gpio-cells : should be 2. First is the pin number and the second gpio flag
  (for instance for the active low flag)
- gpio-controller

Example:
	gpio_low: gpio@10100 {
		compatible = "mrvl,kirkwood-gpio","mrvl,orion-gpio";
		reg = <0x10100 0x40>;
		interrupts = <64>;
		#gpio-cells = <2>;
		gpio-controller;
	};
```

## Documentation/devicetree/bindings/gpio/poweroff-gpio.txt
```
GPIO line that should be set high/low to power off a device

Required properties:
- compatible : should be "gpio-poweroff".
- gpios : The GPIO to set high/low, see "gpios property" in
  Documentation/devicetree/bindings/gpio/gpio.txt. If the pin should be
  low to power down the board set it to "Active Low", otherwise set
  gpio to "Active High".

Examples:

gpio-poweroff {
	compatible = "gpio-poweroff";
	gpios = <&gpio 4 0>; /* GPIO 4 Active High */
};
```

## Documentation/devicetree/bindings/mtd/orion-nand.txt
```
NAND support for Marvell Orion SoC platforms

Required properties:
- compatible : "mrvl,orion-nand".
- reg : Base physical address of the NAND and length of memory mapped
	region

Optional properties:
- cle :
- ale :
- width :
- chip-delay :

Examples:

nand@f4000000 {
	#address-cells = <1>;
	#size-cells = <1>;
	cle = <0>;
	ale = <1>;
	width = <8>;
	chip-delay = <25>;
	compatible = "mrvl,orion-nand";
	reg = <0xf4000000 0x400>;

	partition@0 {
		label = "u-boot";
		reg = <0x0000000 0x100000>;
		read-only;
	};

	partition@100000 {
		label = "uImage";
		reg = <0x0100000 0x200000>;
	};

	partition@300000 {
		label = "dtb";
		reg = <0x0300000 0x100000>;
	};

	partition@400000 {
		label = "root";
		reg = <0x0400000 0x7d00000>;
	};
};
```
